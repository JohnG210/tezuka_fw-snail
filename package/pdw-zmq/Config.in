## package/pdw-zmq/Config.in
```kconfig
config BR2_PACKAGE_PDW_ZMQ
	bool "pdw-zmq"
	select BR2_PACKAGE_ZEROMQ
	help
	  ZMQ publisher daemon for PDW and IQ streaming from EW engine.
	  Publishes PDW records and optionally gated IQ data over ZMQ PUB
	  socket for real-time consumption by host applications.

	  Also installs uio_reg and dma_read helper binaries.
```

## package/snail-moded/Config.in
```kconfig
config BR2_PACKAGE_SNAIL_MODED
	bool "snail-moded"
	depends on BR2_PACKAGE_HOST_RUSTC_TARGET_ARCH_SUPPORTS
	select BR2_PACKAGE_HOST_RUSTC
	help
	  DiSCO-SNAIL mode manager REST API daemon.
	  Provides HTTP endpoints for switching between
	  EW, Sig Int, and Standby firmware modes.
```
